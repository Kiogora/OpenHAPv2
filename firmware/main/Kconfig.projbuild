## firmware/main/Kconfig.projbuild
```kconfig
menu "OpenHAP firmware configuration"

    menu "Hardware validation settings"

        config ENABLE_USER_LED_TEST_HARDWARE_VALIDATION
            bool "Test user LED"
            default y
        config ENABLE_VISUALIZE_I2C_BUS_HARDWARE_VALIDATION
            bool "Visualize devices present on I2C bus"
            default y
        config ENABLE_RTC_TEST_HARDWARE_VALIDATION
            bool "Test onboard RTC"
            default y
        choice
            
            prompt "Choose RTC test mode"
            depends on ENABLE_RTC_TEST_HARDWARE_VALIDATION
            config ENABLE_SNTP_RTC_TEST_HARDWARE_VALIDATION
                bool "Test onboard real time clock using SNTP time over WIFI"
            config ENABLE_STATIC_RTC_TEST_HARDWARE_VALIDATION
                bool "Test onboard real time clock using static time"

        endchoice
        config ENABLE_THERMAL_IMAGER_TEST_HARDWARE_VALIDATION
            bool "Test onboard thermal image sensor"
            default y
        config ENABLE_PM_SENSOR_TEST_HARDWARE_VALIDATION
            bool "Test onboard particulate sensor"
            default y
        config ENABLE_DEFAULT_MAC_ADDRESS_RETRIEVAL_HARDWARE_VALIDATION
            bool "Retrieve OpenHAP MAC address"
            default y

    endmenu

endmenu
```
